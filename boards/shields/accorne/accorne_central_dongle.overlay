#include "accorne_matrix.dtsi"

/delete-node/ &kscan;

/ {
    chosen {
        zmk,kscan = &mock_kscan;
        zmk,underglow = &led_strip;
    };

    mock_kscan: kscan1 {
        compatible = "zmk,kscan-mock";
        columns = <0>;
        rows = <0>;
        events = <0>;
    };
};