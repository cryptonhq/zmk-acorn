## boards/shields/accorne/Kconfig.defconfig
```kconfig
if SHIELD_ACCORNE_CENTRAL_DONGLE || SHIELD_ACCORNE_CENTRAL_LEFT

config ZMK_SPLIT_ROLE_CENTRAL
    default y

endif

if SHIELD_ACCORNE_CENTRAL_DONGLE

config ZMK_KEYBOARD_NAME
    default "corn.dongle"

endif

if SHIELD_ACCORNE_CENTRAL_LEFT

config ZMK_KEYBOARD_NAME
    default "corn.central"

endif

if SHIELD_ACCORNE_PERIPHERAL_LEFT

config ZMK_KEYBOARD_NAME
    default "corn.left"

endif

if SHIELD_ACCORNE_PERIPHERAL_RIGHT

config ZMK_KEYBOARD_NAME
    default "corn.right"

endif

if SHIELD_ACCORNE_CENTRAL_DONGLE || SHIELD_ACCORNE_CENTRAL_LEFT || SHIELD_ACCORNE_PERIPHERAL_LEFT || SHIELD_ACCORNE_PERIPHERAL_RIGHT

config ZMK_SPLIT
    default y

config I2C
    default y

if ZMK_DISPLAY

config SSD1306
    default y

choice LV_FONT_DEFAULT
    default LV_FONT_DEFAULT_MONTSERRAT_12
endchoice

choice ZMK_LV_FONT_DEFAULT_SMALL
    default ZMK_LV_FONT_DEFAULT_SMALL_MONTSERRAT_12
endchoice

config LV_Z_VDB_SIZE
    default 64

config LV_DPI_DEF
    default 148

config LV_Z_BITS_PER_PIXEL
    default 1

choice LV_COLOR_DEPTH
    default LV_COLOR_DEPTH_1
endchoice

endif # ZMK_DISPLAY

endif

# RGB Underglow
menuconfig ZMK_RGB_UNDERGLOW
    bool "RGB Addressable LED Underglow"
    select LED_STRIP
    select ZMK_LOW_PRIORITY_WORK_QUEUE

if ZMK_RGB_UNDERGLOW

# This default value cuts down on tons of excess .conf files, if you're using GPIO, manually disable this
config SPI
    default y

config ZMK_RGB_UNDERGLOW_EXT_POWER
    bool "RGB underglow toggling also controls external power"
    default y

config ZMK_RGB_UNDERGLOW_BRT_MIN
    int "RGB underglow minimum brightness in percent"
    range 0 100
    default 10

config ZMK_RGB_UNDERGLOW_BRT_MAX
    int "RGB underglow maximum brightness in percent"
    range ZMK_RGB_UNDERGLOW_BRT_MIN 100
    default 60

config ZMK_RGB_UNDERGLOW_HUE_STEP
    int "RGB underglow hue step in degrees"
    range 0 359
    default 10

config ZMK_RGB_UNDERGLOW_SAT_STEP
    int "RGB underglow saturation step in percent"
    range 0 100
    default 10

config ZMK_RGB_UNDERGLOW_BRT_STEP
    int "RGB underglow brightness step in percent"
    range 0 100
    default 10

config ZMK_RGB_UNDERGLOW_HUE_START
    int "RGB underglow start hue value in degrees"
    range 0 359
    default 0

config ZMK_RGB_UNDERGLOW_SAT_START
    int "RGB underglow start saturations value in percent"
    range 0 100
    default 100

config ZMK_RGB_UNDERGLOW_BRT_START
    int "RGB underglow start brightness value in percent"
    range ZMK_RGB_UNDERGLOW_BRT_MIN ZMK_RGB_UNDERGLOW_BRT_MAX
    default ZMK_RGB_UNDERGLOW_BRT_MAX

config ZMK_RGB_UNDERGLOW_SPD_START
    int "RGB underglow start animation speed value"
    range 1 5
    default 3

config ZMK_RGB_UNDERGLOW_EFF_START
    int "RGB underglow start effect int value related to the effect enum list"
    range 0 3
    default 0

config ZMK_RGB_UNDERGLOW_ON_START
    bool "RGB underglow starts on by default"
    default y

config ZMK_RGB_UNDERGLOW_AUTO_OFF_IDLE
    bool "Turn off RGB underglow when keyboard goes into idle state"

config ZMK_RGB_UNDERGLOW_AUTO_OFF_USB
    bool "Turn off RGB underglow when USB is disconnected"
    depends on USB_DEVICE_STACK

#ZMK_RGB_UNDERGLOW
endif
```

## boards/shields/accorne/Kconfig.shield
```kconfig
# Copyright (c) 2020 The ZMK Contributors
# SPDX-License-Identifier: MIT

config ACCORNE_CENTRAL_DONGLE
    def_bool $(shields_list_contains,accorne_central_dongle)

config ACCORNE_CENTRAL_LEFT
    def_bool $(shields_list_contains,accorne_central_left)

config ACCORNE_PERIPHERAL_LEFT
    def_bool $(shields_list_contains,accorne_peripheral_left)

config ACCORNE_PERIPHERAL_RIGHT
    def_bool $(shields_list_contains,accorne_peripheral_right)
```
